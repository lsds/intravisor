## Kconfig
```kconfig
choice ARCH
    prompt "Arch"
    default ARCH_RV
    config ARCH_RV
	bool "RISC-V"
    config ARCH_ARM
	bool "Arm"
    config ARCH_X86
	bool "X86"
    endchoice

choice BIT
    prompt "Bit size"
    default BIT_64
    config BIT_64
	bool "64"
    endchoice

choice SELECT_ARCH_MODE
    prompt "Execution Mode"
    default MODE_PURE
    config MODE_PURE
	bool "pure-cap"

    config MODE_HYB
	bool "hybrid-cap"

    config MODE_SIM
	bool "simulation"

    endchoice

choice SELECT_TARGET_OS
    prompt "Select Target OS"
    default OS_CHERIBSD
    config OS_CHERIBSD
	bool "CheriBSD"

    config OS_LINUX
	bool "Linux"

    endchoice


config KERNEL_CONFIGURED_DDC_RELATIVE
	bool "Kernel is configured to support PCC/DDC-relative addressing in cVMs"
	depends on ARCH_ARM
       def_bool y


config DEBUG
	bool "Enable extra debug"
       def_bool n

config ORC
	bool "ORC support"
       def_bool n

config LIBVIRT
	bool "Libvirt support in Intravisor"
       def_bool n

config LKL
	bool "LKL support in Intravisor"
       def_bool n


menu	"LKL Config"
	depends on LKL

config LKL_HEAP_SIZE_MB
	int "Heap size in MB"
	default	200


endmenu

config CHERI_SDK
	string "CHERI SDK"
	default "${HOME}/cheri/output/sdk" if ARCH_RV
	default "${HOME}/cheri/output/morello-sdk" if ARCH_ARM
	default "/usr" if ARCH_X86

config CVM_MAX_SIZE
	hex "max cVM size"
	default	0x10000000
```

## runtime/musl-lkl/lkl/arch/lkl/Kconfig
```kconfig
config LKL
       def_bool y
       depends on !SMP && !MMU && !COREDUMP && !SECCOMP && !UPROBES && !COMPAT && !USER_RETURN_NOTIFIER
       select ARCH_THREAD_STACK_ALLOCATOR
       select RWSEM_GENERIC_SPINLOCK
       select GENERIC_ATOMIC64
       select GENERIC_HWEIGHT
       select FLATMEM
       select FLAT_NODE_MEM_MAP
       select GENERIC_CLOCKEVENTS
       select GENERIC_CPU_DEVICES
       select NO_HZ_IDLE
       select NO_PREEMPT
       select ARCH_WANT_FRAME_POINTERS
       select HAS_DMA
       select DMA_DIRECT_OPS
       select PHYS_ADDR_T_64BIT if 64BIT
       select 64BIT if OUTPUT_FORMAT = "elf64-x86-64"
	   select 64BIT if OUTPUT_FORMAT = "pe-x86-64"
       select HAVE_UNDERSCORE_SYMBOL_PREFIX if OUTPUT_FORMAT = "pe-i386"
       select 64BIT if OUTPUT_FORMAT = "elf64-x86-64-freebsd"
       select 64BIT if OUTPUT_FORMAT = "elf64-littleaarch64"
       select 64BIT if OUTPUT_FORMAT = "elf64-tradbigmips"
       select 64BIT if OUTPUT_FORMAT = "elf64-littleriscv"
       select CPU_BIG_ENDIAN if OUTPUT_FORMAT = "elf64-tradbigmips"
       select BIG_ENDIAN if OUTPUT_FORMAT = "elf64-tradbigmips"
       select CPU_LITTLE_ENDIAN if OUTPUT_FORMAT = "elf64-littleriscv"
       select LITTLE_ENDIAN if OUTPUT_FORMAT = "elf64-littleriscv"
       select MULTIUSER
       select HIGH_RES_TIMERS
       select ARCH_NO_COHERENT_DMA_MMAP
       select HAVE_COPY_THREAD_TLS
       select CLONE_BACKWARDS

config CPU_BIG_ENDIAN
       def_bool n

config OUTPUTFORMAT
       string
       option env="OUTPUT_FORMAT"

config OUTPUT_FORMAT
       string "Output format"
       default OUTPUTFORMAT

config ARCH_DMA_ADDR_T_64BIT
       def_bool 64BIT

config 64BIT
       def_bool n

config BIG_ENDIAN
       def_bool n

config LITTLE_ENDIAN
       def_bool n


config GENERIC_CSUM
       def_bool y

config GENERIC_HWEIGHT
       def_bool y

config NO_IOPORT_MAP
       def_bool y

config RWSEM_GENERIC_SPINLOCK
	bool
	default y

config FORCE_MAX_ZONEORDER
	int "Maximum zone order"
	default "11"

source init/Kconfig

source net/Kconfig

source drivers/Kconfig

source fs/Kconfig

source mm/Kconfig

source kernel/Kconfig.preempt

source kernel/Kconfig.locks

source kernel/Kconfig.hz

source security/Kconfig

source crypto/Kconfig

source lib/Kconfig

source lib/Kconfig.debug
```
